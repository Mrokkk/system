## arch/arm/config.in
```kconfig
choice 'Machine' \
    "RaspberryPi    CONFIG_RASPI \
     Versatile      CONFIG_VERSATILE" Versatile
```

## arch/config.in
```kconfig
# Select architecture
choice "Target architecture"    \
    "x86    CONFIG_X86          \
     arm    CONFIG_ARM"         x86

if [ $CONFIG_X86 = "y" ]; then
    arch=x86
elif [ $CONFIG_ARM = "y" ]; then
    arch=arm
fi
```

## arch/x86/config.in
```kconfig
choice 'Processor type' \
    "386        CONFIG_M386 \
     486        CONFIG_M486 \
     Pentium    CONFIG_M586 \
     PPro       CONFIG_M686 \
     CoreDuo    CONFIG_COREDUO \
     Core2Duo   CONFIG_CORE2DUO" Core2Duo
```
